/dts-v1/;
/plugin/;
/ {
  fragment@0 {
    target = <&uarta>;
    __overlay__ {
      status = "okay";
      // serial-tegra RX-DMA UAF (tegra_uart_rx_buffer_push) corrupts
      // small frames + panics; no "rx"/"tx" in dma-names => force PIO
      dma-names = "none";
    };
  };
};
